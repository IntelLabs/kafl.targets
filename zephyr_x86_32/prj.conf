## CMakeLists.txt
```
# SPDX-License-Identifier: Apache-2.0

cmake_minimum_required(VERSION 3.13.1)

find_package(Zephyr REQUIRED HINTS $ENV{ZEPHYR_BASE})

project(kafl_agent LANGUAGES C)
set_property(TARGET app PROPERTY C_STANDARD 99)

target_sources(app PRIVATE src/main.c)
# add root kafl.targets directory to include path to find nyx_api.h header
target_include_directories(app PRIVATE ${CMAKE_CURRENT_SOURCE_DIR}/..)
# add /usr/local/include in case we are in the Docker container
target_include_directories(app PRIVATE /usr/local/include)

# Select a fuzzing target at a time, e.g. ``cmake ../ -D KAFL_TEST=y''
target_sources_ifdef(KAFL_TEST  app PRIVATE src/target_test.c)
target_sources_ifdef(KAFL_FS    app PRIVATE src/target_fs.c)
target_sources_ifdef(KAFL_JSON  app PRIVATE src/target_json.c)
```

## prj.conf
```kconfig
#CONFIG_FLASH_BASE_ADDRESS=0x100000
#CONFIG_SRAM_BASE_ADDRESS=0x500000
#
CONFIG_SRAM_SIZE=8192
#CONFIG_FLASH_SIZE=2048

# need to accomodate PAYLOAD_SIZE (~128kb)
CONFIG_MAIN_STACK_SIZE=262144

# 32bit PAE MMU not supported in Nyx-Qemu
CONFIG_X86_MMU=n

# optimization settings?
#CONFIG_DEBUG_OPTIMIZATIONS=y
#CONFIG_NO_OPTIMIZATIONS=y

# enable available protections to help us catch bugs
CONFIG_ASSERT=y
CONFIG_HW_STACK_PROTECTION=y
CONFIG_STACK_CANARIES=y

# disable spectre/meltdown mitigations for kAFL build
CONFIG_X86_KPTI=n

# build with address sanitizer - only available for CONFIG_ARCH_POSIX
#CONFIG_ASAN=y

# UMODE test?
CONFIG_USERSPACE=n

# JSON test
CONFIG_JSON_LIBRARY=y

# FS test
CONFIG_DISK_ACCESS=y
CONFIG_FILE_SYSTEM=y
CONFIG_FAT_FILESYSTEM_ELM=y

CONFIG_QEMU_ICOUNT=n
```

## src/main.c
```c
/*
 * Copyright 2020 Intel Corporation
 *
 * SPDX-License-Identifier: Apache-2.0
 */

#include <zephyr/kernel.h>
#include <zephyr/fatal.h>
#include <zephyr/sys/check.h>

#include <stdlib.h>
#include <stdint.h>
#include <stdbool.h>
#include <string.h>

#define _GNU_SOURCE
#include <nyx_api.h>
#include "target.h"

#define PAYLOAD_MAX_SIZE (128*1024)

#ifndef PAYLOAD_ON_HEAP
static uint8_t bss_buffer[PAYLOAD_MAX_SIZE] __attribute__((aligned(4096)));
#endif

static void agent_init(void *panic_handler, void *kasan_handler)
{
	hprintf("Initiate fuzzer handshake...\n");

	kAFL_hypercall(HYPERCALL_KAFL_ACQUIRE, 0);
	kAFL_hypercall(HYPERCALL_KAFL_RELEASE, 0);
	
	kAFL_hypercall(HYPERCALL_KAFL_SUBMIT_CR3, 0);
	kAFL_hypercall(HYPERCALL_KAFL_USER_SUBMIT_MODE, KAFL_MODE_32);

	/* submit panic and optionally kasan handlers for qemu override */
	if (panic_handler) {
		kAFL_hypercall(HYPERCALL_KAFL_SUBMIT_PANIC, (uintptr_t)panic_handler);
	}

	if (kasan_handler) {
		kAFL_hypercall(HYPERCALL_KAFL_SUBMIT_KASAN, (uintptr_t)kasan_handler);
	}

	/* Request information on available (host) capabilites (not optional) */
	volatile host_config_t host_config;
	kAFL_hypercall(HYPERCALL_KAFL_GET_HOST_CONFIG, (uintptr_t)&host_config);
	if (host_config.host_magic != NYX_HOST_MAGIC ||
	    host_config.host_version != NYX_HOST_VERSION) {
		hprintf("host_config magic/version mismatch!\n");
		habort("GET_HOST_CNOFIG magic/version mismatch!\n");
	}
	hprintf("\thost_config.bitmap_size: 0x%lx\n", host_config.bitmap_size);
	hprintf("\thost_config.ijon_bitmap_size: 0x%lx\n", host_config.ijon_bitmap_size);
	hprintf("\thost_config.payload_buffer_size: 0x%lx\n", host_config.payload_buffer_size);

	//uint8_t *trace_buffer = mmap(NULL, MMAP_SIZE(TRACE_BUFFER_SIZE), PROT_READ | PROT_WRITE, MAP_SHARED | MAP_ANONYMOUS, -1, 0);
	//memset(trace_buffer, 0, TRACE_BUFFER_SIZE);  // makes sure that the bitmap buffer is already

	/* reserved guest memory must be at least as large as host SHM view */
	if (PAYLOAD_MAX_SIZE < host_config.payload_buffer_size) {
		habort("Insufficient guest payload buffer!\n");
	}

	/* submit agent configuration */
	volatile agent_config_t agent_config = {0};
	agent_config.agent_magic = NYX_AGENT_MAGIC;
	agent_config.agent_version = NYX_AGENT_VERSION;

	agent_config.agent_tracing = 0; // trace by host!
	agent_config.agent_ijon_tracing = 0; // no IJON
	agent_config.agent_non_reload_mode = 1; // allow persistent
	agent_config.coverage_bitmap_size = host_config.bitmap_size;

	kAFL_hypercall(HYPERCALL_KAFL_SET_AGENT_CONFIG, (uintptr_t)&agent_config);
}

//#define PAYLOAD_ON_HEAP
static void agent_run(void)
{
	kAFL_payload* payload_buffer;

#ifndef PAYLOAD_ON_HEAP
	payload_buffer = (kAFL_payload*)bss_buffer;
#else
	/* fixme: GET_PAYLOAD requires page-aligned buffer! */
	payload_buffer = k_malloc(PAYLOAD_MAX_SIZE);
	if (!payload_buffer) {
		habort("Failed to allocate payload_buffer!");
		return;
	}
#endif

	/* touch the memory to ensure all pages are present in memory */
	memset(payload_buffer, 0, PAYLOAD_MAX_SIZE);

	kAFL_hypercall(HYPERCALL_KAFL_GET_PAYLOAD, (uintptr_t)payload_buffer);

	target_init();
	hprintf("Target init done...\n");

	while (1) {
		kAFL_hypercall(HYPERCALL_KAFL_NEXT_PAYLOAD, 0);
		kAFL_hypercall(HYPERCALL_KAFL_ACQUIRE, 0);
		//hprintf("target_entry()...\n");
		target_entry(payload_buffer->data, payload_buffer->size);

		kAFL_hypercall(HYPERCALL_KAFL_RELEASE, 0);
	}
}

/*
 * That function is weak symbol on Zephyr, just override it with our
 * function to notify KVM through hypercall.
 */
void k_sys_fatal_error_handler(unsigned int reason, const z_arch_esf_t *esf)
{
	switch (reason) {
		case K_ERR_KERNEL_OOPS:
			kAFL_hypercall(HYPERCALL_KAFL_KASAN, 0);
			break;
		case K_ERR_CPU_EXCEPTION:
		case K_ERR_KERNEL_PANIC:
		default:
			kAFL_hypercall(HYPERCALL_KAFL_PANIC, 0);
			break;
	}

	k_fatal_halt(reason);
}

void main(void)
{
	hprintf("kAFL Hello World! %s\n\n", CONFIG_BOARD);
	
	// skip rewrite in favor of custom k_sys_fatal_error_handler()
	void* panic_handler = NULL;
	void* kasan_handler = NULL;

	hprintf("Kernel Panic Handler Address:\t%p\n", panic_handler);

	if (kasan_handler){
		hprintf("Kernel KASAN Handler Address:\t%p\n", kasan_handler);
	}

	agent_init(panic_handler, kasan_handler);
	agent_run();
}
```

## src/kafl_user.h
```c
/*
 * kAFl/Nyx low-level interface definitions
 *
 * Copyright 2022 Sergej Schumilo, Cornelius Aschermann
 * Copyright 2022 Intel Corporation
 *
 * SPDX-License-Identifier: MIT
 */

#ifndef KAFL_USER_H
#define KAFL_USER_H

#include <stdarg.h>
#include <stdio.h>

#ifdef __MINGW64__
#ifndef uint64_t
#define uint64_t UINT64
#endif
#ifndef int32_t
#define int32_t INT32
#endif
#ifndef uint8_t
#define uint8_t UINT8
#endif
#else 
#include <stdint.h>
#endif

#define HYPERCALL_KAFL_RAX_ID				0x01f
#define HYPERCALL_KAFL_ACQUIRE				0
#define HYPERCALL_KAFL_GET_PAYLOAD			1
#define HYPERCALL_KAFL_GET_PROGRAM			2  /* deprecated */
#define HYPERCALL_KAFL_GET_ARGV				3  /* deprecated */
#define HYPERCALL_KAFL_RELEASE				4
#define HYPERCALL_KAFL_SUBMIT_CR3			5
#define HYPERCALL_KAFL_SUBMIT_PANIC			6
#define HYPERCALL_KAFL_SUBMIT_KASAN			7
#define HYPERCALL_KAFL_PANIC				8
#define HYPERCALL_KAFL_KASAN				9
#define HYPERCALL_KAFL_LOCK					10 /* deprecated */
#define HYPERCALL_KAFL_INFO					11 /* deprecated */
#define HYPERCALL_KAFL_NEXT_PAYLOAD			12
#define HYPERCALL_KAFL_PRINTF				13
#define HYPERCALL_KAFL_PRINTK_ADDR			14 /* deprecated */
#define HYPERCALL_KAFL_PRINTK				15 /* deprecated */

/* user space only hypercalls */
#define HYPERCALL_KAFL_USER_RANGE_ADVISE	16
#define HYPERCALL_KAFL_USER_SUBMIT_MODE		17
#define HYPERCALL_KAFL_USER_FAST_ACQUIRE	18
/* 19 is already used for exit reason KVM_EXIT_KAFL_TOPA_MAIN_FULL */
#define HYPERCALL_KAFL_USER_ABORT			20
#define HYPERCALL_KAFL_TIMEOUT				21 /* deprecated */
#define HYPERCALL_KAFL_RANGE_SUBMIT		29
#define HYPERCALL_KAFL_REQ_STREAM_DATA		30
#define HYPERCALL_KAFL_PANIC_EXTENDED		32

#define HYPERCALL_KAFL_CREATE_TMP_SNAPSHOT	33
#define HYPERCALL_KAFL_DEBUG_TMP_SNAPSHOT	34 /* hypercall for debugging / development purposes */

#define HYPERCALL_KAFL_GET_HOST_CONFIG		35
#define HYPERCALL_KAFL_SET_AGENT_CONFIG		36

#define HYPERCALL_KAFL_DUMP_FILE			37

#define HYPERCALL_KAFL_REQ_STREAM_DATA_BULK 38
#define HYPERCALL_KAFL_PERSIST_PAGE_PAST_SNAPSHOT 39

/* hypertrash only hypercalls */
#define HYPERTRASH_HYPERCALL_MASK			0xAA000000

#define HYPERCALL_KAFL_NESTED_PREPARE		(0 | HYPERTRASH_HYPERCALL_MASK)
#define HYPERCALL_KAFL_NESTED_CONFIG		(1 | HYPERTRASH_HYPERCALL_MASK)
#define HYPERCALL_KAFL_NESTED_ACQUIRE		(2 | HYPERTRASH_HYPERCALL_MASK)
#define HYPERCALL_KAFL_NESTED_RELEASE		(3 | HYPERTRASH_HYPERCALL_MASK)
#define HYPERCALL_KAFL_NESTED_HPRINTF		(4 | HYPERTRASH_HYPERCALL_MASK)gre

#define PAYLOAD_SIZE						(128 << 10)				/* up to 128KB payloads */
#define HPRINTF_MAX_SIZE					0x1000					/* up to 4KB hprintf strings */

#define KAFL_MODE_64	0
#define KAFL_MODE_32	1
#define KAFL_MODE_16	2

typedef struct {
	int32_t size;
	uint8_t data[PAYLOAD_SIZE-sizeof(int32_t)];
} kAFL_payload;

typedef struct {
	uint64_t ip[4];
	uint64_t size[4];
	uint8_t enabled[4];
} kAFL_ranges; 

#if defined(__i386__)
static inline uint32_t kAFL_hypercall(uint32_t p1, uint32_t p2)
{
	uint32_t nr = HYPERCALL_KAFL_RAX_ID;
	asm volatile ("vmcall"
				  : "=a" (nr)
				  : "a"(nr), "b"(p1), "c"(p2));
	return nr;
}
#elif defined(__x86_64__)
static inline uint64_t kAFL_hypercall(uint64_t p1, uint64_t p2)
{
	uint64_t nr = HYPERCALL_KAFL_RAX_ID;
	asm volatile ("vmcall"
				  : "=a" (nr)
				  : "a"(nr), "b"(p1), "c"(p2));
	return nr;
}
#endif

static void habort(char* msg) {
	kAFL_hypercall(HYPERCALL_KAFL_USER_ABORT, (uintptr_t)msg);
}

static void hprintf(const char * format, ...)  __attribute__ ((unused));
static void hprintf(const char * format, ...){
	static char hprintf_buffer[HPRINTF_MAX_SIZE] __attribute__((aligned(4096)));

	va_list args;
	va_start(args, format);
	vsnprintk((char*)hprintf_buffer, HPRINTF_MAX_SIZE, format, args);
	//printf("%s", hprintf_buffer);
	kAFL_hypercall(HYPERCALL_KAFL_PRINTF, (uintptr_t)hprintf_buffer);
	va_end(args);
}

typedef struct host_config_s {
	uint32_t bitmap_size;
	uint32_t ijon_bitmap_size;
	uint32_t payload_buffer_size;
	/* more to come */
} __attribute__((packed)) host_config_t;

typedef struct agent_config_s {
	uint8_t agent_timeout_detection;
	uint8_t agent_tracing;
	uint8_t agent_ijon_tracing;
	uint8_t agent_non_reload_mode;
	uint64_t trace_buffer_vaddr;
	uint64_t ijon_trace_buffer_vaddr;
	uint8_t dump_payloads; /* set by hypervisor */
	/* more to come */
} __attribute__((packed)) agent_config_t;

typedef struct kafl_dump_file_s {
	uint64_t file_name_str_ptr;
	uint64_t data_ptr;
	uint64_t bytes;
	uint8_t append;
} __attribute__((packed)) kafl_dump_file_t;

typedef struct req_data_bulk_s {
	char file_name[256];
	uint64_t num_addresses;
	uint64_t addresses[479];
} req_data_bulk_t;

#endif /* KAFL_USER_H */
```

## src/target_fs.c
```c
/*
 * Zephyr FS fuzzing sample
 *
 * This is not really working. Can you fix it?
 *
 * lsdir() function and other snippets taken from Zephyr RTOS project
 * samples/subsys/fs/fat_fs/src/main.c
 *
 * Copyright 2019-2020 Intel Corporation
 * SPDX-License-Identifier: Apache-2.0
 */

#include <zephyr/zephyr.h>
#include <zephyr/kernel.h>
#include <zephyr/fs/fs.h>
#include <ff.h>

#include <string.h>
#include <sys/types.h>

static FATFS fat_fs;
static struct fs_mount_t mp = {
	.type = FS_FATFS,
	.fs_data = &fat_fs,
};

static const char *disk_mount_pt = "/SD:";

void target_init() {};

static int lsdir(const char *path)
{
    int res;
    struct fs_dir_t dirp;
    static struct fs_dirent entry;

    /* Verify fs_opendir() */
    res = fs_opendir(&dirp, path);
    if (res) {
        printk("Error opening dir %s [%d]\n", path, res);
        return res;
    }

    printk("\nListing dir %s ...\n", path);
    for (;;) {
        /* Verify fs_readdir() */
        res = fs_readdir(&dirp, &entry);

        /* entry.name[0] == 0 means end-of-dir */
        if (res || entry.name[0] == 0) {
            break;
        }

        if (entry.type == FS_DIR_ENTRY_DIR) {
            printk("[DIR ] %s\n", entry.name);
        } else {
            printk("[FILE] %s (size = %zu)\n",
                entry.name, entry.size);
        }
    }

    /* Verify fs_closedir() */
    res = fs_closedir(&dirp);

    return res;
}

ssize_t target_entry(void *buf, size_t len)
{
	int rc = 0;

	mp.fs_data = buf;
	mp.mnt_point = disk_mount_pt;

	int res = fs_mount(&mp);

	if (res == FR_OK) {
		printk("Disk mounted.\n");
		lsdir(disk_mount_pt);
		fs_unmount(&mp);
	} else {
		printk("Error mounting disk.\n");
	}

	return rc;
}
```

## src/target_json.c
```c
/*
 * Zephyr json fuzzing sample
 *
 * This file is in part based on Zephyr RTOS project
 * tests/lib/json/src/main.c
 *
 * Copyright 2020 Intel Corporation
 * SPDX-License-Identifier: Apache-2.0
 */

#include <zephyr/kernel.h>
#include <zephyr/data/json.h>

#include <string.h>
#include <sys/types.h>

/*
 * Structs and description are part of Zephyr's test
 */
struct test_nested {
	int nested_int;
	bool nested_bool;
	const char *nested_string;
};

struct test_struct {
	const char *some_string;
	int some_int;
	bool some_bool;
	struct test_nested some_nested_struct;
	int some_array[16];
	size_t some_array_len;
	bool another_bxxl;               /* JSON field: "another_b!@l" */
	bool if_;                        /* JSON: "if" */
	int another_array[10];           /* JSON: "another-array" */
	size_t another_array_len;
	struct test_nested xnother_nexx; /* JSON: "4nother_ne$+" */
};

static const struct json_obj_descr nested_descr[] = {
	JSON_OBJ_DESCR_PRIM(struct test_nested, nested_int, JSON_TOK_NUMBER),
	JSON_OBJ_DESCR_PRIM(struct test_nested, nested_bool, JSON_TOK_TRUE),
	JSON_OBJ_DESCR_PRIM(struct test_nested, nested_string,
			JSON_TOK_STRING),
};

static const struct json_obj_descr description[] = {
	JSON_OBJ_DESCR_PRIM(struct test_struct, some_string, JSON_TOK_STRING),
	JSON_OBJ_DESCR_PRIM(struct test_struct, some_int, JSON_TOK_NUMBER),
	JSON_OBJ_DESCR_PRIM(struct test_struct, some_bool, JSON_TOK_TRUE),
	JSON_OBJ_DESCR_OBJECT(struct test_struct, some_nested_struct,
			nested_descr),
	JSON_OBJ_DESCR_ARRAY(struct test_struct, some_array,
			16, some_array_len, JSON_TOK_NUMBER),
	JSON_OBJ_DESCR_PRIM_NAMED(struct test_struct, "another_b!@l",
			another_bxxl, JSON_TOK_TRUE),
	JSON_OBJ_DESCR_PRIM_NAMED(struct test_struct, "if",
			if_, JSON_TOK_TRUE),
	JSON_OBJ_DESCR_ARRAY_NAMED(struct test_struct, "another-array",
			another_array, 10, another_array_len,
			JSON_TOK_NUMBER),
	JSON_OBJ_DESCR_OBJECT_NAMED(struct test_struct, "4nother_ne$+",
			xnother_nexx, nested_descr),
};

void target_init() {};

ssize_t target_entry(const char *buf, size_t len)
{
	int ret;
	struct test_struct desc;

	ret = json_obj_parse((char *)buf, len, description,
			ARRAY_SIZE(description), &desc);

	return (ssize_t)ret;
}
```

## src/target_test.c
```c
/*
 * Zephyr TEST fuzzing sample target
 *
 * Based on kAFL kafl_vuln_test module
 *
 * Copyright 2017 Sergej Schumilo
 * Copyright 2019-2020 Intel Corporation
 *
 * SPDX-License-Identifier: Apache-2.0
 */

#include <zephyr/kernel.h>

#include <string.h>
#include <sys/types.h>

const size_t INPUT_LENGTH = 32;

void target_init() {};

ssize_t target_entry(const char *buf, size_t len)
{
	char input[INPUT_LENGTH];

	if (len >= INPUT_LENGTH) {
		len = INPUT_LENGTH-1;
	}

	memcpy(input, buf, len);
	input[len] = '\0';
	//printk("TARGET_TEST: %s\n", input);
	

	if(input[0] == 'K')
		if(input[1] == 'E')
			if(input[2] == 'R')
				if(input[3] == 'N')
					if(input[4] == 'E')
						if(input[5] == 'L')
							if(input[6] == 'A')
								if(input[7] == 'F')
									if(input[8] == 'L') {
										printk("BUG: KERNELAFL\n");
										k_panic(); /* boom! bug incoming... */
									}

	if(input[0] == 'S')
		if(input[1] == 'E')
			if(input[2] == 'R')
				if(input[3] == 'G')
					if(input[4] == 'E')		
						if(input[5] == 'J') {
							printk("BUG: SERGEJ\n");
							k_panic();
						}

	/* memory corruption */
	if(input[0] == 'K'){
    	if(input[1] == 'A'){
        	if(input[2] == 'S'){
            	if(input[3] == 'A'){
                	if(input[4] == 'N') {
						printk("BUG: KASAN\n");
						k_oops();
					}
				}
        	}
        }
	}

	if (0 == strncmp(input, "RedQueen", strlen("RedQueen"))) {
		printk("BUG: RedQueen\n");
		k_oops();
	}

	return len;
}
```
